behaviors {
    macro_gui_layer: macro_gui_layer {
        compatible = "zmk,behavior-macro";
        #binding-cells = <0>;
        bindings = <
            &macro_press &kp LGUI
            &macro_press &mo 5
            &macro_pause_for_release
            &macro_release &kp LGUI
            &macro_release &mo 5
        >;
    };

    ht_k_gui: ht_k_gui {
        compatible = "zmk,behavior-hold-tap";
        #binding-cells = <2>;
        flavor = "balanced";
        tapping-term-ms = <280>;
        require-prior-idle-ms = <125>;
        bindings = <&kp>, <&kp>;
    };

    td_k_gui: td_k_gui {
        compatible = "zmk,behavior-tap-dance";
        #binding-cells = <0>;
        tapping-term-ms = <175>;
        bindings = <&ht_k_gui LGUI K>, <&macro_gui_layer>;
    };
};
